## main/Kconfig.projbuild
```kconfig
menu "JOMOO SQ9650 Voice Controller"

    config TOILET_TARGET_MAC
        string "Toilet BLE MAC address (format: AA:BB:CC:DD:EE:FF)"
        default "A4:C1:38:5E:79:76"
        help
            BLE MAC address of the JOMOO toilet to connect.
            Colon-separated hexadecimal. Rebuild after changing.

    config ASR_UART_BAUD_RATE
        int "ASR-PRO UART baud rate"
        default 115200
        help
            UART baud rate between ASR-PRO voice module and ESP32.

    config ASR_UART_RX_PIN
        int "ASR-PRO TXD to ESP32 RX GPIO number"
        default 17
        help
            GPIO number for UART2 RX pin (receives data from ASR-PRO TXD).

    config ASR_UART_TX_PIN
        int "ESP32 TX to ASR-PRO RXD GPIO number"
        default 16
        help
            GPIO number for UART2 TX pin (sends data to ASR-PRO PA3/RXD).
            Used for voice feedback: ESP32 sends a single status byte back
            to ASR-PRO, which plays the matching voice prompt (e.g.
            'connected', 'foot sensor on'). This line is required.

    config BLE_IDLE_TIMEOUT_SEC
        int "BLE idle timeout in seconds (auto disconnect)"
        default 30
        help
            After wake word triggers BLE connection, if no command is
            received within this many seconds, ESP32 will automatically
            disconnect from the toilet to free the BLE slot.

    config ENABLE_DEBUG_CONSOLE
        bool "Enable debug console on UART0 (test without ASR-PRO)"
        default y
        help
            Start an interactive command console on the flashing/monitor
            UART (UART0), so you can type commands like 'wake', 'footon'
            to test BLE control before the ASR-PRO voice module arrives.
            Disable this for production firmware.

    config TOILET_AP_SSID
        string "Provisioning hotspot SSID prefix"
        default "Toilet-Setup"
        help
            WiFi provisioning hotspot SSID prefix. The last 2 bytes of
            the MAC address are appended to avoid conflicts, e.g.
            "Toilet-Setup-A1B2".

    config TOILET_AP_PASS
        string "Provisioning hotspot password"
        default "12345678"
        help
            WPA2 password of the provisioning hotspot (min 8 chars).

    config RESET_BUTTON_GPIO
        int "Factory reset button GPIO (active low, internal pull-up)"
        default 0
        help
            GPIO of the physical reset button. Hold for RESET_BUTTON_HOLD_MS
            to clear WiFi credentials and reboot into provisioning mode.
            Default 0 is the BOOT button on ESP32 dev boards.

    config RESET_BUTTON_HOLD_MS
        int "Factory reset hold time (ms)"
        default 5000
        range 1000 60000
        help
            How long the button must be held to trigger a factory reset.

endmenu
```
